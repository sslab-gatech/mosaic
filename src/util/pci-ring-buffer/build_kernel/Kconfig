## src/util/pci-ring-buffer/build_kernel/Kconfig
```kconfig
#
# pci ring buffer support
#
config PCI_RING_BUFFER
	tristate "ring buffer over PCIe bus based on SCIF"
	default m

config PCI_RING_BUFFER_TEST
	tristate "test master ring buffer"
	default m
```
